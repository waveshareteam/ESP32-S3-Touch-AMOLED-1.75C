## examples/esp-idf/01_AXP2101/main/Kconfig.projbuild
```kconfig
menu "AXP2101 PMU Configuration"

    config I2C_MASTER_PORT_NUM
        int "PMU I2C Port Number"
        default 1
        help
            Port number for I2C Master device.

    config I2C_MASTER_FREQUENCY
        int "Master Frequency"
        default 100000
        help
            I2C Speed of Master device.

    config PMU_I2C_SCL
        int "PMU SCL GPIO Num"
        default 14
        help
            GPIO number for I2C PMU clock line.

    config PMU_I2C_SDA
        int "PMU SDA GPIO Num"
        default 15
        help
            GPIO number for I2C PMU data line.

endmenu
```
